## components/i2c_manager/Kconfig
```kconfig
menu "i2c Manager Configuration"

    config I2C_PORT_NUM
        int "I2C Port Number"
        default 0
        range 0 1
        help
            I2C port number to use (I2C0 or I2C1).

    config I2C_SDA_PIN
        int "I2C SDA Pin"
        default 6
        help
            GPIO pin for I2C SDA.

    config I2C_SCL_PIN
        int "I2C SCL Pin"
        default 7
        help
            GPIO pin for I2C SCL.

    config I2C_SLAVE_ADDRESS
        hex "I2C Slave Device Address"
        default 0x28
        help
            7-bit I2C address of the slave device to communicate with.

    config I2C_GLITCH_IGNORE_CNT
        int "I2C Glitch Ignore Control Duration"
        default 7
        help
            Glitch Ignore Control period threshold (noise filtering)

    config I2C_FREQUENCY_HZ
        int "I2C Frequency (Hz)"
        default 100000
        help
            Frequency for I2C communication in Hertz.

endmenu
```

## components/uart_manager/Kconfig
```kconfig
menu "UART Manager Configuration"

    config UART_PORT_NUM
        int "UART Port Number"
        default 1
        range 0 2
        help
            UART port number to use (UART0, UART1, or UART2).
            Note: UART0 is typically used for console/logging.

    config UART_BAUD_RATE
        int "UART Baud Rate"
        default 115200
        help
            Baud rate for UART communication.

    config UART_TX_PIN
        int "UART TX Pin"
        default 21
        help
            GPIO pin for UART TX.

    config UART_RX_PIN
        int "UART RX Pin"
        default 20
        help
            GPIO pin for UART RX.

    config UART_RX_BUFFER_SIZE
        int "UART RX Buffer Size"
        default 1024
        help
            Size of the UART RX buffer in bytes.

    config UART_TX_BUFFER_SIZE
        int "UART TX Buffer Size"
        default 1024
        help
            Size of the UART TX buffer in bytes.

endmenu
```

## components/wifi_manager/Kconfig
```kconfig
menu "WiFi Manager Configuration"

    config WIFI_MAX_CONNECTIONS
        string "Max Connections"
        default 4
        help
            Max connections allowed for the Wi-Fi server.

    config WIFI_SSID
        string "WiFi SSID"
        default "MyESP32AP"
        help
            SSID (network name) for the WiFi access point.

    choice WIFI_AUTH_MODE
        prompt "WiFi Authentication Mode"
        default WIFI_AUTH_WPA2
        help
            Select the authentication mode for the WiFi AP.

        config WIFI_AUTH_OPEN
            bool "Open (No Password)"
        config WIFI_AUTH_WPA2
            bool "WPA2-PSK (Requires Password)"
    endchoice

    config WIFI_PASSWORD
        string "WiFi Password"
        default "changeme123"
        depends on WIFI_AUTH_WPA2
        help
            Password for WiFi AP (8-63 characters for WPA2).
            This option only appears if WPA2 authentication is selected.

endmenu
```

## sdkconfig.defaults
```kconfig
CONFIG_WIFI_SSID="MyESP32AP"
CONFIG_WIFI_PASSWORD="changeme123"
CONFIG_WIFI_MAX_CONNECTIONS=4
```
